## WifiConnect/sdkconfig.defaults
```kconfig
#define WIFI_SSID "your_ssid"
#define WIFI_PASS "your_password"
# CONFIG_COMPILER_WARNINGS_AS_ERRORS is not set
```

## ble_battery_client/sdkconfig.defaults
```kconfig
# Enable BLE
CONFIG_BT_ENABLED=y
CONFIG_BT_BLUEDROID_ENABLED=y

# BLE controller mode
CONFIG_BTDM_CTRL_MODE_BLE_ONLY=y

# BLE client settings
CONFIG_BT_GATTC_ENABLE=y
CONFIG_BT_GATTC_CACHE_NVS_FLASH=n

# BLE Security features
CONFIG_BT_BLE_SMP_ENABLE=y

# Log levels
CONFIG_LOG_DEFAULT_LEVEL_INFO=y

# Power saving
CONFIG_PM_ENABLE=n
```

## ble_cccd_server/sdkconfig.defaults
```kconfig
# Enable Bluetooth
CONFIG_BT_ENABLED=y
CONFIG_BT_BLE_ENABLED=y
CONFIG_BT_GATTS_ENABLE=y

# Set the maximum number of characteristics and descriptors
CONFIG_BT_GATT_MAX_SR_PROFILES=8
CONFIG_BT_GATT_MAX_SR_ATTRIBUTES=100

# Enable automatic service change notifications
CONFIG_BT_GATTS_SEND_SERVICE_CHANGE_AUTO=y

# Enable the GATT client for testing
CONFIG_BT_GATTC_ENABLE=y
CONFIG_BT_GATTC_MAX_CACHE_CHAR=40

# Enable SMP for security
CONFIG_BT_BLE_SMP_ENABLE=y

# Set BLE host stack to full mode (both controller and host)
CONFIG_BT_CTRL_MODE_BR_EDR_ONLY=n
CONFIG_BT_CTRL_MODE_BLE_ONLY=y

# Use NIMBLE stack (more efficient)
CONFIG_BT_NIMBLE_ENABLED=y
```

## blink/sdkconfig.defaults
```kconfig
# Default to ESP32 since that's a common target
CONFIG_IDF_TARGET="esp32"

# Serial monitor configuration
CONFIG_ESPTOOLPY_MONITOR_BAUD_115200B=y
CONFIG_ESPTOOLPY_MONITOR_BAUD=115200
```
